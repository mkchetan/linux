## drivers/net/wwan/Kconfig
```kconfig
# SPDX-License-Identifier: GPL-2.0-only
#
# Wireless WAN device configuration
#

menuconfig WWAN
	bool "Wireless WAN"
	depends on NET
	help
	  This section contains all Wireless WAN (WWAN) device drivers.

	  If you have one of those WWAN M.2 Modules and wish to use it in Linux
	  say Y here and also to the Module specific WWAN Device Driver.

	  If unsure, say N.

if WWAN
source "drivers/net/wwan/iosm/Kconfig"
endif # WWAN
```

## drivers/net/wwan/iosm/Kconfig
```kconfig
# SPDX-License-Identifier: (GPL-2.0-only)
#
# IOSM Driver configuration
#
# Copyright (C) 2020-21 Intel Corporation
#

config IOSM
	tristate "IOSM Driver"
	depends on INTEL_IOMMU
	help
	  This driver enables Intel M.2 WWAN Device communication.

	  If you have one of those Intel M.2 WWAN Modules and wish to use it in
	  Linux say Y/M here.

	  If unsure, say N.
```
